## firmware/encoder-ec11/sdkconfig.defaults
```kconfig
CONFIG_IDF_TARGET="esp32p4"
CONFIG_ESPTOOLPY_FLASHSIZE_32MB=y
CONFIG_ESPTOOLPY_FLASHSIZE="32MB"
CONFIG_ESP_CONSOLE_UART_DEFAULT=y
CONFIG_FREERTOS_HZ=1000
```

## firmware/foc/sdkconfig.defaults
```kconfig
CONFIG_IDF_TARGET="esp32p4"

# 实际 Flash 为 32MB
CONFIG_ESPTOOLPY_FLASHSIZE_32MB=y
CONFIG_ESPTOOLPY_FLASHSIZE="32MB"

# 日志走 UART0
CONFIG_ESP_CONSOLE_UART_DEFAULT=y
CONFIG_FREERTOS_HZ=1000
CONFIG_LOG_DEFAULT_LEVEL_INFO=y
```

## firmware/ws2812-rainbow/sdkconfig.defaults
```kconfig
# 目标芯片
CONFIG_IDF_TARGET="esp32p4"

# 日志走 UART0 (CH343 串口即可看到输出)
CONFIG_ESP_CONSOLE_UART_DEFAULT=y

# FreeRTOS tick 100Hz 足够
CONFIG_FREERTOS_HZ=100

# 关闭无关的省电/编译噪音
CONFIG_LOG_DEFAULT_LEVEL_INFO=y

# 实际 Flash 为 32MB
CONFIG_ESPTOOLPY_FLASHSIZE_32MB=y
CONFIG_ESPTOOLPY_FLASHSIZE="32MB"
```
